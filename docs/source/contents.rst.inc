.. contents:: Table of Contents

General
-------

This section provides a general overview of the project.

.. toctree::
   :maxdepth: 1

   summary
   screenshots
   sample_labs
   federation
   technical
   publications
   contact


Users
-----

This section is intended for people who is going to install the WebLab-Deusto
system.

.. toctree::
   :maxdepth: 2

   installation
   first_steps
   installation_next_steps
   performance
   directory_hierarchy
   authentication
   tools
   configuration
   upgrade


Remote laboratory development and management
--------------------------------------------

This section is intended for people who is going to create a new laboratory
using the WebLab-Deusto tools.

.. toctree::
   :maxdepth: 2

   remote_lab_development
   remote_lab_deployment
   remote_lab_sharing

External systems
----------------

This section is intended for people who is going to integrate WebLab-Deusto in
external systems, such as Learning Management Systems, Content Management
Systems, OAuth providers or similar.

.. toctree::
   :maxdepth: 2

   federation_for_external_tools
   lms4labs
   other_approaches

WebLab-Deusto Development
-------------------------

This section is intended for people who is going to contribute to the WebLab-Deusto
system itself, rather than remote laboratories on top of it.

.. toctree::
   :maxdepth: 2

   contributing
   development

Appendixes
----------

.. toctree::

   download_from_github
   userguide_boole_weblab_es
